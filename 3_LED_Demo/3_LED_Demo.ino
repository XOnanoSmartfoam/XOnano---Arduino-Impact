
// This script is designed to allow an impact on a piece of Smartfoam to 
// light up one of 3 LEDS: Green for low impact, Yellow for medium, and
// Red for high impact.
// Sam Wilding
// 9/13/18

//Still needs work
// - The triggering is still sensitive to false positives when wires get bumped
// - The thresholds aren't working very well. The same drop will light yellow or red about equally
// - sum "integration" is probably not the best way to determine impact level. Max voltage may be better
// - Noise level should be checked with nothing happening. I added a 100R resister between AREF and VCC (5V) and a .1 microf capactior from AREF to ground. The effect of this on noise hasn't competely been determined yet.

#include <stdlib.h>
#define array_size 50
#define buffer_size 5
int volt_digital = 0;
int i;
int led_state = 0;
long wait_time = 2000 + millis();
int threshold = 150;
int trigger[buffer_size];
int volt_array[array_size];
int max_volt = 0;
float volt_avg;
int volt_sum;
int trigger_sum;

float voltage = 0.0;

String volt_AVG;
String volt_SUM;
String trigger_SUM;
String VOLTAGE;

int j = 0;
double avg_reading = 0.0;

void setup() {
  // put your setup code here, to run once:
  pinMode(11, OUTPUT); //Green LED
  pinMode(12, OUTPUT); //Yellow LED
  pinMode(13, OUTPUT); //Red LED 
  Serial.begin (9600);
  analogReference(DEFAULT);
  Serial.println("CLEARSHEET"); // clears sheet starting at row 1
  Serial.println("LABEL,Time,Voltage,Volt Sum,Trigger Sum");
  //Serial.println("CUSTOMBOX3,LABEL,Quit at 450?");
  
}

void loop() {
  //LEDs on indicate that the system is monitoring waiting to be triggered.
  digitalWrite(11, HIGH);
  digitalWrite(12, HIGH);
  digitalWrite(13, HIGH);
  
  
  volt_avg = 0.0;
  volt_sum = 0;
  trigger_sum = 0;
  j = 0;
  avg_reading = 0;
  //volt_digital = analogRead(0);
while(j < 5){
    

// Sit in the loop and measure analog input until the threshold is exceeded.
// trigger_sum is the sum of bugger_size values. Triggering off one reading 
// resulted in too many false positives based on noise. Since writing this 
// code I have added some filtering to the AREF pin on the Arudino so the noise
// may be low enough to trigger of one value but I haven't checked that yet
/*
  while (trigger_sum < threshold) {
    trigger_sum = 0;
    for (i = 0; i < buffer_size; i++) {
      trigger[i] = analogRead(0);
      trigger_sum +=  trigger[i];
      //Hold to a sample rate of about 1000 Hz
      delay(1);
    }
    //Serial.println("trigger sum is:");
    //Serial.println(trigger_sum);
  }
  //Serial.println("left trigger loop");
  */
// Lights low, indicating that measuring is triggered
  digitalWrite(11, LOW);
  digitalWrite(12, LOW);
  digitalWrite(13, LOW);

// Once triggered, measure array_size more values. volt_sum is more or less
// a simple integration of the voltage data. This may not be the best way to
// determine impact levels. Peak voltage may be a better indication but before
// AREF was filtered the peak was too noisy. Peaks may be cleaned up now but
// I haven't had time to check

  for (i = 0; i < array_size; i++) { //array_size = 50
    volt_array[i] = analogRead(A2);
    //Serial.println("analogRead gave: ");
    //Serial.println(volt_array[i]);
    volt_sum +=  volt_array[i];
    // Sample at 1000 Hz
    delay(1);
  }
  //Serial.println(volt_sum);

// This ensures any high voltages generated by an impact that were used to trigger
// additional measurement are included in the "integration". I'm making the assumption
// that values before impact and after impact contribute little to the "integration"
// and I'm not filtering them out at this point.
  
  volt_sum += trigger_sum;

// Just some printing to the serial port for some analysis
  //for (i = 0; i < array_size; i++) {
    //Serial.println(volt_array[i]);
  //}

  //Serial.print("volt_sum is ");
  //Serial.println(volt_sum);

  //Serial.print("trigger_sum is ");
  //Serial.println(trigger_sum);
/*  
// Delay just so we can see the LEDs go low
  delay(1000);

//Trigger the Green LED, lowest impact level
  if (volt_sum < 8000) {
    digitalWrite(11, HIGH);
    delay(1000);
    digitalWrite(11, LOW);
  }
//Trigger the Yellow LED, middle impact level
  else if (volt_sum < 12000) {
    digitalWrite(12, HIGH);
    delay(1000);
    digitalWrite(12, LOW);
  }

//Trigger the Red LED, High impact level
  else {
    digitalWrite(13, HIGH);
    delay(1000);
    digitalWrite(13, LOW);
  }
*/

if (volt_sum > volt_sum < 8000) {
    Serial.println("light hit");
  }
//Trigger the Yellow LED, middle impact level
  else if (volt_sum < 12000) {
    Serial.println("Medium hit");
  }

//Trigger the Red LED, High impact level
  else {
    Serial.println("HARD HIT");
  }

avg_reading += volt_sum;
  j++;

}

avg_reading = avg_reading / 5;

//volt_sum = volt_sum / 5;
voltage = (avg_reading / 50 * 4.5) / 1024.0;
//voltage = voltage / 5;
//Serial.print("Voltage: ");
//Serial.println(voltage);
//volt_AVG = volt_avg;
volt_SUM = avg_reading;
trigger_SUM = trigger_sum;
VOLTAGE = voltage; //Adding 15 to see what happens
//dtostrf(volt_avg, 1, 1, 10);
//String volt_AVG = volt_avg;
//String volt_SUM = volt_sum;
//String trigger_SUM = trigger_sum; 
Serial.println("Data,TIME," + VOLTAGE + ',' + volt_SUM + "," + trigger_SUM);
delay(10);


} 
